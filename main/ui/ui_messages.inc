    {" · 单文件 ≤ 1 MB", " · Per file ≤ 1 MB"},
    {"%d / %d · 上下滑动切换", "%d / %d · Swipe up/down"},
    {"%d 张 · JPG / PNG", "%d images · JPG / PNG"},
    {"%d 本图书 · 已选 %u 本", "%d books · %u selected"},
    {"%d个文件夹 · %d个文件", "%d folders · %d files"},
    {"%llu分钟", "%llu min"},
    {"%llu小时%llu分", "%lluh %llum"},
    {"%lu 分钟", "%lu min"},
    {"%lu 次", "%lu"},
    {"%s %u 本图书？", "%s %u books?"},
    {"%s · 剩余 %.1f MB%s", "%s · Free %.1f MB%s"},
    {"%s 副本 %d%s", "%s copy %d%s"},
    {"%s 副本%s", "%s copy%s"},
    {"%s失败（%s）", "%s failed (%s)"},
    {"%u 个 · %u/%u 页", "%u networks · %u/%u"},
    {"%u 字 · 点按切换", "%u chars · Tap to change"},
    {"%u 篇文档 · 已选 %u 篇", "%u documents · %u selected"},
    {"%u 节", "%u sections"},
    {"%u 节 ›", "%u sections ›"},
    {"%u/%u · 全书 %u%%", "%u/%u · Book %u%%"},
    {"1  在电脑上等待复制完成", "1  Wait for copying to finish on the computer."},
    {"10分钟", "10 minutes"},
    {"1分钟", "1 minute"},
    {"2  安全弹出 SD_CARD，再结束读卡", "2  Safely eject SD_CARD, then stop USB storage."},
    {"30分钟", "30 minutes"},
    {"3分钟", "3 minutes"},
    {"5分钟", "5 minutes"},
    {"BOOT 刷机", "BOOT flashing"},
    {"Banner区域设置", "Banner settings"},
    {"EN / 中", "EN / ZH"},
    {"EPUB、TXT 书籍", "EPUB / TXT books"},
    {"GitHub访问受限，请稍后重试", "GitHub rate limit reached. Retry later."},
    {"JPG / JPEG / PNG · 单张不超过 2 MB", "JPG / JPEG / PNG · Up to 2 MB each"},
    {"MD 文档保存至 markdown，在内容页阅读。", "MD files go to markdown and are read in Content."},
    {"Pico 已关机", "Pico is off"},
    {"Pico 热点", "Pico hotspot"},
    {"TF 卡", "TF card"},
    {"TF 卡 txt / epub 阅读", "TXT / EPUB on TF card"},
    {"TF 卡 · %s · 已读 %u%%", "TF card · %s · %u%% read"},
    {"TF 卡不可用", "TF card unavailable."},
    {"TF 卡不可用，请重新挂载后打开", "TF card unavailable. Remount before opening."},
    {"TF 卡升级", "TF card update"},
    {"TF 卡容量  %.1f GB", "TF capacity  %.1f GB"},
    {"TF 卡尚未挂载", "TF card not mounted."},
    {"TF 卡已移除", "TF card removed."},
    {"TF 卡已移除，原存储已停用", "TF card removed; previous storage disabled."},
    {"TF 卡文件与传输", "TF files & transfer"},
    {"TF 卡根目录", "TF card root"},
    {"TF 卡根目录未找到 Pico-IF-update.bin", "Pico-IF-update.bin not found in the TF root."},
    {"TF 卡目录", "TF folders"},
    {"TF余", "TF free"},
    {"TF卡%s", "TF card %s"},
    {"TF卡不可用或剩余空间不足", "TF card unavailable or insufficient space."},
    {"TF卡不可用或空间不足", "TF unavailable or full."},
    {"TF卡准备失败", "TF card preparation failed."},
    {"TF卡同步恢复未完成，原文件已保留", "TF sync recovery incomplete; original files retained."},
    {"TF卡恢复未完成", "TF recovery incomplete."},
    {"TF卡未挂载", "TF card not mounted."},
    {"TF卡记录保存失败，近期记录仍保留", "Cannot save TF history; recent records are retained."},
    {"TTF、OTF 字体", "TTF / OTF fonts"},
    {"USB 写入未完成：%s，请在电脑弹出后重试", "USB write incomplete: %s. Eject on the computer, then retry."},
    {"USB 模式启动失败：%s", "Cannot start USB: %s"},
    {"USB 读卡", "USB storage"},
    {"USB 读卡未开启", "USB storage is off."},
    {"USB连接", "USB"},
    {"WiFi 传书", "WiFi transfer"},
    {"WiFi 传书未启动", "WiFi transfer not started."},
    {"WiFi 对时完成，内部时钟已接管", "WiFi time synced; internal clock is active."},
    {"WiFi 尚未连接，请稍后再试", "WiFi is not connected. Try later."},
    {"WiFi/热点", "Wifi"},
    {"WiFi启动失败", "WiFi start failed."},
    {"WiFi未连接，请检查网络设置", "WiFi not connected. Check network settings."},
    {"WiFi未连接，请检查网络配置", "WiFi not connected. Check network settings."},
    {"WiFi未连接，请检查网络配置后重试", "WiFi not connected. Check settings and retry."},
    {"markdown文档", "Markdown documents"},
    {"obsidian端一键推送插件可联系作者获取", "Get the Obsidian one-click send plugin from the author."},
    {"一级标题", "Heading 1"},
    {"三级标题", "Heading 3"},
    {"上一级", "Parent folder"},
    {"上一页", "Previous page"},
    {"上一页 Prev", "Previous"},
    {"上下位置", "Vertical position"},
    {"上传失败，请重试", "Upload failed. Retry."},
    {"上／中／下", "Top / center / bottom"},
    {"下一页", "Next page"},
    {"下一页 Next", "Next"},
    {"下载图片", "Download images"},
    {"下载或安装失败，当前版本已保留", "Download or install failed; current version retained."},
    {"下载文件", "Download file"},
    {"下载未完成，原内容已保留", "Download incomplete; original content retained."},
    {"下载校验失败，请重试", "Download verification failed. Retry."},
    {"不保存退出", "Exit without saving"},
    {"不启用", "Disabled"},
    {"不能移入自身文件夹", "Cannot move a folder into itself."},
    {"与手机或电脑连接同一个无线网络", "Use the same WiFi network as your phone or computer."},
    {"中 / EN", "ZH / EN"},
    {"中文拼音", "Chinese Pinyin"},
    {"为 Pico 打造的阅读系统", "A reading system for Pico"},
    {"为Obsidian用户打造的Pico系统", "A Pico OS for Obsidian users"},
    {"书名", "Book title"},
    {"书名不能为空", "Book title cannot be empty."},
    {"书签", "Bookmarks"},
    {"书签保存失败", "Cannot save bookmark."},
    {"书签列表", "Bookmarks"},
    {"书签已添加", "Bookmark added"},
    {"书签已移除", "Bookmark removed"},
    {"书籍", "book"},
    {"书籍、字体和图片仍需留在 TF 卡。", "Books, fonts and images must remain on the TF card."},
    {"书籍目录", "Books folder"},
    {"二级标题", "Heading 2"},
    {"云端传输中断", "Cloud transfer interrupted."},
    {"云端传输中断，正在重新下载…", "Cloud transfer interrupted; downloading again…"},
    {"云端传输未完成，请检查WiFi后重试", "Transfer incomplete. Check WiFi and retry."},
    {"云端内容已删除", "Cloud file deleted."},
    {"云端内容已删除，请刷新目录", "Cloud file deleted. Refresh the list."},
    {"云端内容已更新，请刷新目录", "Cloud file updated. Refresh the list."},
    {"云端正文或图片校验不一致，请重新下载", "Cloud text/image verification failed. Download again."},
    {"云端读取失败", "Cloud read failed."},
    {"云端读取失败，请检查同步目录", "Cloud read failed. Check the sync folder."},
    {"云端连接失败", "Cloud connection failed."},
    {"云端连接失败，请检查网络和系统时间", "Cloud connection failed. Check network and system time."},
    {"云端连接较慢，正在重试…", "Cloud connection slow; retrying…"},
    {"仅清阅读进度，保留图书文件", "Clear progress only; keep the book file."},
    {"仅清阅读进度，保留文档和图片", "Clear progress only; keep the document and images."},
    {"仅清阅读进度，所有文件保留", "Clear progress only; keep all files."},
    {"仅清除当前 WiFi，不影响其他网络和图书", "Forget this WiFi only; keep other networks and books."},
    {"从 TF 卡恢复配置", "Restore from TF"},
    {"从书架移除", "Remove from shelf"},
    {"以及坚果云服务", "and Nutstore"},
    {"传书 Transfer", "Transfer"},
    {"传输、存储卡与数字拼豆", "Transfer, storage & Cyber Beads"},
    {"传输期间暂停计时", "The timer pauses during transfers."},
    {"传输未完成，请检查网络后重试", "Transfer incomplete. Check the network and retry."},
    {"传输正在结束，请稍后再试", "Transfer is stopping. Try later."},
    {"使用此文件夹", "Use this folder"},
    {"使用说明", "Instructions"},
    {"使用默认壁纸", "Use default wallpaper"},
    {"保", "Sa"},
    {"保存", "Save"},
    {"保存与恢复", "Save & restore"},
    {"保存与恢复配置", "Save & restore"},
    {"保存失败，请检查 TF 卡剩余空间", "Save failed. Check free space on the TF card."},
    {"保存失败，请检查书名或存储", "Save failed. Check title or storage."},
    {"保存失败，请检查设置存储空间", "Save failed. Check settings storage."},
    {"保存失败，请重试", "Save failed. Try again."},
    {"保存失败，输入已保留，请重试", "Save failed; input retained. Retry."},
    {"保存并退出", "Save and exit"},
    {"保存当前配置到 TF 卡", "Save settings to TF"},
    {"保存文件", "Save file"},
    {"保存时间", "Save time"},
    {"信号一般", "Fair signal"},
    {"信号强", "Strong signal"},
    {"信号良好", "Good signal"},
    {"修改字号", "Text size"},
    {"停止传输服务", "Stop transfer service"},
    {"充电中", "Charging"},
    {"先浅后深  ›", "Sleep, then off  ›"},
    {"先浅睡，10 分钟后深睡", "Sleep, then power off after 10 minutes"},
    {"全屏", "Full screen"},
    {"全部来源", "All sources"},
    {"关机", "Shut down"},
    {"关机与休眠", "Power & sleep"},
    {"关机睡眠", "Power & sleep"},
    {"关联插图与阅读进度也会删除", "Linked images and progress will also be removed."},
    {"关闭", "Off"},
    {"关闭  ›", "Off  ›"},
    {"其他尺寸将等比例缩放、居中裁切。", "Other sizes are scaled and center-cropped."},
    {"内存不足，仅列 %d 本；释放后重扫", "Low memory: showing %d books. Free memory and rescan."},
    {"内存不足，复制失败", "Low memory; copy failed."},
    {"内存不足，无法保留删除重试记录", "Not enough memory to retain deletion retries."},
    {"内存不足，无法保留待保存进度", "Not enough memory to retain unsaved progress."},
    {"内存不足，无法开始升级", "Not enough memory to start the update."},
    {"内存不足，无法打开图书", "Not enough memory to open this book."},
    {"内存不足，请稍后重试", "Not enough memory. Try later."},
    {"内存不足，请重启后重试", "Not enough memory. Restart and retry."},
    {"内存已清理，请点下方按钮重试", "Memory cleaned. Tap below to retry."},
    {"内容已达到长度上限", "Input length limit reached."},
    {"内容无效或保存失败", "Invalid content or save failed."},
    {"内容校验失败", "Content verification failed."},
    {"内置", "Internal"},
    {"内置余", "Internal free"},
    {"内置存储", "Internal storage"},
    {"内置存储单本限 1 MB", "Internal storage allows up to 1 MB per book."},
    {"内置灰阶测试图", "Built-in grayscale test"},
    {"再次点按，确认恢复配置", "Tap again to restore"},
    {"写入中断，当前版本保持不变", "Write interrupted; current version retained."},
    {"准备TF卡失败（%s）", "Cannot prepare TF card (%s)."},
    {"准备下载所选内容", "Preparing selected downloads…"},
    {"准备中", "Preparing"},
    {"准备读取坚果云目录", "Preparing to list Nutstore files…"},
    {"准备连接坚果云…", "Preparing Nutstore connection…"},
    {"分", "Min"},
    {"切回稳定版", "Return to stable"},
    {"切换阅读布局", "Switch layout"},
    {"创作6阶拼豆壁纸", "Create 6-tone bead wallpapers"},
    {"删除", "Delete"},
    {"删除书签模式", "Delete bookmarks"},
    {"删除后文件无法恢复", "Deleted files cannot be recovered."},
    {"删除后无法恢复，是否继续？", "Deletion cannot be undone. Continue?"},
    {"删除失败，请重试", "Delete failed. Retry."},
    {"删除所选", "Delete selected"},
    {"删除文件", "Delete file"},
    {"删除文件不可撤销，失败项可重试", "File deletion cannot be undone; failed items can be retried."},
    {"删除未完成，请检查 TF 卡", "Deletion incomplete. Check the TF card."},
    {"删除这条书签？", "Delete this bookmark?"},
    {"删除选中的 %u 篇文档？", "Delete %u selected documents?"},
    {"刷新", "now"},
    {"前往 设置 → 坚果云", "Go to Settings > Nutstore"},
    {"前往传输  ›", "Open transfer  ›"},
    {"功能", "Functions"},
    {"加入日期", "Date added"},
    {"加密网络密码至少 8 个字符", "Encrypted networks need at least 8 password characters."},
    {"加载失败，请检查存储卡后重试", "Load failed. Check the card and retry."},
    {"勾选下载并离线阅读", "Select files for offline reading."},
    {"包含阅读记录、设备资料、WiFi和坚果云。", "Includes history, device profile, WiFi and Nutstore."},
    {"北京时间 · UTC+8", "Beijing time · UTC+8"},
    {"升级包不属于当前 Pico 固件", "Update is for a different Pico firmware."},
    {"升级包不是有效的 Pico 固件", "Not a valid Pico firmware image."},
    {"升级包与当前版本相同", "Update matches the current version."},
    {"升级包为空", "Update file is empty."},
    {"升级包已通过初步检查", "Update passed preliminary checks."},
    {"升级包无法读取", "Cannot read update file."},
    {"升级包版本信息无效", "Invalid update version information."},
    {"升级包超过固件分区容量", "Update exceeds firmware partition size."},
    {"升级包身份不匹配，已停止安装", "Update identity mismatch. Installation stopped."},
    {"升级期间请保持供电", "Keep power connected during the update."},
    {"单击", "Tap"},
    {"单指向上滑动", "Swipe up"},
    {"单指向下滑动", "Swipe down"},
    {"单指向右滑动", "Swipe right"},
    {"单指向左滑动", "Swipe left"},
    {"原因：%s", "Reason: %s"},
    {"双指张开", "Pinch out"},
    {"双指捏合", "Pinch in"},
    {"双指轻点", "Two-finger tap"},
    {"发现新版本，请确认后安装", "New version found. Confirm to install."},
    {"取", "Can"},
    {"取消", "Cancel"},
    {"取消同步", "Cancel sync"},
    {"取消移动", "Cancel move"},
    {"取消置顶", "Unpin"},
    {"口令：", "Password: "},
    {"只移出书架，文件与阅读进度都保留", "Remove from shelf only; keep files and progress."},
    {"可切回稳定版，版本号将降低", "An earlier stable version is available."},
    {"可用版本", "Available version"},
    {"可用空间暂无法读取", "Free space unavailable."},
    {"同名文件会覆盖；完成后自动更新书架", "Same-name files overwrite; the shelf updates automatically."},
    {"同名文件已经存在", "This file name already exists."},
    {"同步", "Sync"},
    {"同步任务启动失败", "Sync task start failed."},
    {"同步内存不足", "Not enough memory for sync."},
    {"同步失败", "Sync failed"},
    {"同步失败，请重试", "Sync failed. Retry."},
    {"同步完成", "Sync complete"},
    {"同步完成：成功%u项，失败%u项", "Sync complete: %u succeeded, %u failed."},
    {"同步已取消，已入库文件保留", "Sync cancelled; imported files retained."},
    {"同步恢复尚未完成，请重新进入同步页", "Sync recovery incomplete. Reopen the sync page."},
    {"同步所选（%u）", "Sync selected (%u)"},
    {"同步文件夹", "Sync folder"},
    {"同步文件夹不存在", "Sync folder not found."},
    {"同步文件夹不存在，请检查设置", "Sync folder not found. Check settings."},
    {"同步文件夹中还没有可读内容", "No supported files in the sync folder."},
    {"同步文件夹填写坚果云根目录下已存在的文件夹", "Use an existing folder in the Nutstore root."},
    {"同步未完成，请检查网络、配置和TF卡", "Sync incomplete. Check network, settings and TF card."},
    {"同网浏览器上传 · 已完成 %u 本", "Upload on the same network · %u completed"},
    {"名称倒序", "Name: Z–A"},
    {"名称正序", "Name: A–Z"},
    {"名称过长，无法在设备上编辑", "Name too long to edit on the device."},
    {"周", "weeks"},
    {"周一", "Mon"},
    {"周三", "Wed"},
    {"周二", "Tue"},
    {"周五", "Fri"},
    {"周六", "Sat"},
    {"周四", "Thu"},
    {"周日", "Sun"},
    {"固件信息", "Firmware info"},
    {"固件分区不兼容，请使用电脑刷机", "Incompatible partitions. Use USB flashing."},
    {"固件完整性校验失败", "Firmware integrity check failed."},
    {"固定壁纸", "Fixed wallpaper"},
    {"图书", "Books"},
    {"图书 Books", "Books"},
    {"图书与文档共用，实体按键不变", "Shared by books and documents; hardware keys stay the same."},
    {"图书已更新，旧待保存进度已作废", "Book updated; old pending progress discarded."},
    {"图书排序", "Sort books"},
    {"图书放入 TF 卡的 books 文件夹后会自动出现在书架。", "Books appear automatically after copying them into books on the TF card."},
    {"图书详情", "Book details"},
    {"图书资源过大或章节过多", "Book resources too large or too many chapters."},
    {"图片", "Images"},
    {"图片列表内存不足，请返回后重试", "Low memory for image list. Return and retry."},
    {"图片对比 Images", "Images"},
    {"图片已保存，残局保存失败，请重试", "Image saved; could not save the board. Retry."},
    {"图片无法打开", "Cannot open image."},
    {"图片无法读取，请重新选择", "Cannot read image. Select it again."},
    {"图片无法预览", "Cannot preview image."},
    {"图片格式不支持", "Unsupported image format."},
    {"图片超过 2 MB 或无法读取", "Image exceeds 2 MB or cannot be read."},
    {"在每本书开始时显示", "Show when starting each book"},
    {"在线升级", "Online update"},
    {"坚果云", "Nutstore"},
    {"坚果云同步", "Nutstore"},
    {"坚果云同步与无线传书", "Nutstore sync & wireless transfer"},
    {"坚果云账号", "Nutstore account"},
    {"坚果云账号或应用密码不可用", "Nutstore account or app password unavailable."},
    {"坚果云限制访问，请稍后重试", "Nutstore rate limit reached. Retry later."},
    {"基于 kiikoread", "Based on kiikoread"},
    {"基于 kiikoread（原 Pico Reader）", "Based on kiikoread (formerly Pico Reader)"},
    {"基础操作", "Basic controls"},
    {"壁纸轮播", "Shuffle wallpapers"},
    {"备份含WiFi和坚果云应用密码，请妥善保管。", "Backup includes WiFi and Nutstore app passwords. Keep it private."},
    {"复制", "Copy"},
    {"复制失败，请检查空间", "Copy failed. Check free space."},
    {"复核文件版本", "Recheck file version"},
    {"多久不操作后进入休眠", "Sleep after no input for:"},
    {"大", "Large"},
    {"大写", "Uppercase"},
    {"天", "days"},
    {"字体", "Font"},
    {"字体保存失败，请重试", "Cannot save font. Try again."},
    {"字体无法加载", "Cannot load font."},
    {"字体正在使用", "Font in use"},
    {"字体目录", "Fonts folder"},
    {"字体重排失败，请重新打开图书", "Font layout failed. Reopen the book."},
    {"字号", "Size"},
    {"字号保存或排版失败，请重试", "Cannot save size or rebuild layout. Retry."},
    {"字间距", "Letter spacing"},
    {"存", "ve"},
    {"存储不可用，请检查 TF 卡", "Storage unavailable. Check the TF card."},
    {"存储卡", "Storage card"},
    {"存储卡管理", "Storage"},
    {"存储已移除，传书已停止", "Storage removed; transfer stopped."},
    {"安装 TF 卡升级包", "Install TF update"},
    {"安装完成，即将重启", "Installed. Restarting shortly."},
    {"安装完成，即将重新启动", "Installed. Restarting shortly."},
    {"安装新版本", "Install update"},
    {"安装期间请保持供电", "Keep power connected during installation."},
    {"完全断电，长按电源键开机", "Power off fully; hold power to start."},
    {"完成", "Done"},
    {"完成传输", "Finish transfer"},
    {"完成日期与时间设置后显示阅读记录", "Set date & time to show reading history."},
    {"定期全刷", "Full refresh"},
    {"实现更自由便携的阅读体验", "Read freely, wherever you go"},
    {"容量未知", "Capacity unknown"},
    {"密码须 8–63 字符或 64 位十六进制", "Use 8–63 characters or 64 hexadecimal digits."},
    {"对齐方式", "Alignment"},
    {"导入图书", "Import books"},
    {"将删除文件夹内所有内容，无法恢复", "All contents in this folder will be deleted permanently."},
    {"小", "Small"},
    {"小写", "Lowercase"},
    {"尚无正在传输的文件", "No file is being transferred."},
    {"尚无记录，开始使用后逐步积累", "No history yet. Records appear as you use Pico."},
    {"尚无阅读进度", "No reading progress yet."},
    {"尚未保存网络", "No saved network."},
    {"尚未选择 WiFi", "No WiFi selected"},
    {"尚未配置", "Not configured"},
    {"左／中／右", "Left / center / right"},
    {"已保存", "Saved"},
    {"已保存  ›", "Saved  ›"},
    {"已保存 · 尚未连接", "Saved · Not connected"},
    {"已保存到 TF 卡根目录", "Saved to the TF card root."},
    {"已保存到 pictures/pindou", "Saved to pictures/pindou"},
    {"已保存的 WiFi", "Saved WiFi"},
    {"已保存网络", "Saved network"},
    {"已保存，尚未连接", "Saved, not connected"},
    {"已入库 %u / %u", "Imported %u / %u"},
    {"已取消", "Cancelled"},
    {"已在此文件夹", "Already in this folder."},
    {"已复制：%.74s", "Copied: %.74s"},
    {"已开始记录，稍后可查看电量曲线", "Recording started. Check the chart later."},
    {"已断开，连接信息保留", "Disconnected; credentials retained."},
    {"已有阅读进度", "Reading started"},
    {"已用 %.1f GB · 可用 %.1f GB", "Used %.1f GB · Free %.1f GB"},
    {"已用 %.1f/%.1f GB", "Used %.1f/%.1f GB"},
    {"已移出书架 %u 本，失败 %u 本%s", "Removed %u books; %u failed%s"},
    {"已绑定%s", "Assigned to %s"},
    {"已获取网络时间，内部时钟写入失败", "Network time received, but internal clock write failed."},
    {"已设为系统字体", "Set as system font."},
    {"已连接", "Connected"},
    {"已连接 %u 台 · 已完成 %u 本", "%u devices · %u books completed"},
    {"已连接，可传书和对时", "Connected; transfer and time sync are available."},
    {"已选择", "Selected"},
    {"已遗忘网络", "Network forgotten."},
    {"已配置  ›", "Configured  ›"},
    {"布局", "layout"},
    {"常规", "Normal"},
    {"年", "Year"},
    {"应用", "Apps"},
    {"应用密码", "App password"},
    {"应用密码不是账户密码，在 设置-第三方应用管理 中添加生成", "Generate an app password in Settings > Third-party apps; do not use your login password."},
    {"应用密码独立于坚果云登录密码", "Use an app password, not your Nutstore login password."},
    {"建议使用Agent管理电脑端的该文件夹", "An agent can help manage this folder on your computer."},
    {"开启", "On"},
    {"开启  ›", "On  ›"},
    {"开放网络", "Open network"},
    {"开放网络保存失败，请重试", "Cannot save open network. Retry."},
    {"当前", "Current"},
    {"当前书籍", "Current book"},
    {"当前固件没有可用的 OTA 分区", "No OTA partition available."},
    {"当前文字超出四行或高度，请修改文字", "Text exceeds four lines or available height. Please edit it."},
    {"当前无需升级", "No update needed."},
    {"当前时间 · 北京时间", "Current time · Beijing"},
    {"当前版本", "Current version"},
    {"当前筛选没有图书", "No books match this filter."},
    {"当前系统不支持此更新源", "This update source is not supported."},
    {"当前网络", "Current network"},
    {"彻底关机", "Power off"},
    {"彻底断电  ›", "Power off  ›"},
    {"待读取目录", "Ready to list files"},
    {"快捷手势", "Quick gestures"},
    {"快捷操作保存失败，请重试", "Cannot save gesture. Retry."},
    {"思源黑体", "Noto Sans SC"},
    {"思源黑体（TF 卡）", "Noto Sans SC (TF)"},
    {"恢复将覆盖当前设置，请再点按一次确认", "Restore overwrites settings. Tap again to confirm."},
    {"恢复居中", "Center line"},
    {"恢复未完成，请重试", "Restore incomplete. Try again."},
    {"成功 %u 本，失败 %u 本%s", "Succeeded %u; failed %u%s"},
    {"成功 %u 篇，失败 %u 篇%s", "Succeeded %u; failed %u%s"},
    {"所选内容同名，请一次选择其中一篇", "Selected documents have matching names. Select only one."},
    {"所选内容有同名文件", "Duplicate selected file names."},
    {"手动设置", "Set manually"},
    {"手机与 Pico 连接同一网络", "Connect your phone and Pico to the same network."},
    {"手机或电脑扫码后，即可在浏览器上传内容", "Scan with your phone/computer to upload in a browser."},
    {"打开传书网页", "Open upload page"},
    {"打开坚果云设置", "Open Nutstore settings"},
    {"打开目录", "Open contents"},
    {"打开面板", "Open panel"},
    {"扫描失败，请点下方按钮重试", "Scan failed. Tap below to retry."},
    {"扫描没有完成", "Scan incomplete."},
    {"拉取在线文件", "Download cloud files"},
    {"拼音已达到长度上限", "Pinyin length limit reached."},
    {"按周", "Weekly"},
    {"按日", "Daily"},
    {"换机或刷机后，快速恢复个性化设置", "Restore preferences after reinstalling or changing devices."},
    {"换行", "Newline"},
    {"排序", "Sort"},
    {"排序保存失败，请重试", "Cannot save sort order. Retry."},
    {"排版失败，请重试", "Layout failed. Try again."},
    {"排版失败：内存不足或章节过长", "Layout failed: low memory or chapter too long."},
    {"推荐尺寸：684×300 像素。", "Recommended: 684×300 pixels."},
    {"搜索", "Search"},
    {"搜索中", "Searching"},
    {"搜索图书", "Search books"},
    {"搜索文档", "Search documents"},
    {"搭配Send to E-ink Reader插件", "With Send to E-ink Reader"},
    {"操作区域保存失败，请重试", "Cannot save tap layout. Retry."},
    {"操作已取消", "Cancelled."},
    {"操作示例", "Controls guide"},
    {"操作说明偏好保存失败，请重试", "Cannot save guide preference. Retry."},
    {"支持 2.4 GHz WiFi（信道 1–13）", "2.4 GHz WiFi (channels 1–13)"},
    {"支持 EPUB、TXT、MD 文档、字体和图片。", "Supports EPUB, TXT, MD, fonts and images."},
    {"支持 PNG、JPG/JPEG 格式。", "PNG, JPG/JPEG supported."},
    {"支持md/txt/epub、PNG/JPEG图片及TTF字体，自动分类保存", "MD/TXT/EPUB, PNG/JPEG and TTF files are saved to their matching folders."},
    {"支持md文档的Pico固件", "Pico firmware with Markdown"},
    {"支持中文、拼音首字母、完整拼音或英文", "Search Chinese, Pinyin, initials or English."},
    {"放大字号", "Larger text"},
    {"数字 / 符号  1/2", "Numbers / symbols  1/2"},
    {"数字 / 符号  2/2", "Numbers / symbols  2/2"},
    {"数字拼豆", "Cyber Beads"},
    {"文件不可读，请检查 TF 卡和书籍文件", "Cannot read file. Check the card and book."},
    {"文件删除失败，请检查存储后重试", "Delete failed. Check storage and retry."},
    {"文件名过长", "File name too long."},
    {"文件夹", "Folder"},
    {"文件夹已删除", "Folder deleted."},
    {"文件存放位置", "File locations"},
    {"文件已删除", "File deleted."},
    {"文件已删除，进度清理失败，请重试", "File deleted, but progress cleanup failed. Retry."},
    {"文件扩展名保持不变", "The file extension is kept unchanged."},
    {"文件格式或压缩方式暂不支持", "Unsupported format or compression."},
    {"文件管理 Files", "Files"},
    {"文件管理重命名", "Rename in Files"},
    {"文件超过大小上限", "File exceeds the size limit."},
    {"文字", "Text"},
    {"文字排版、设备资料、阅读记录与书签", "Text layout, device profile, history and bookmarks"},
    {"文字最多四行，请缩短内容或缩小字号", "Up to four lines. Shorten text or reduce its size."},
    {"文字超过四行或高度，请缩小字号或缩短文字", "Text exceeds four lines or available height. Reduce size or shorten it."},
    {"文档", "Documents"},
    {"文档与插图保留，阅读进度归零", "Keep documents and images; reset progress."},
    {"文档删除或清理失败，请重试", "Document deletion or cleanup failed. Retry."},
    {"文档名", "Document name"},
    {"文档字号", "Document sizes"},
    {"文档或插图未完整入库，请检查后重试", "Document or images are incomplete. Check and retry."},
    {"文档排序", "Sort documents"},
    {"文档目录由同步管理；删除请在内容页操作", "Synced document folder; delete from Content."},
    {"文档目录请通过坚果云同步管理", "Manage the document folder through Nutstore sync."},
    {"文档详情", "Document details"},
    {"文档读取失败，请重试", "Cannot read document. Try again."},
    {"文档重命名请在 Obsidian 中操作", "Rename documents in Obsidian."},
    {"文章已更新，请刷新", "Document updated. Refresh."},
    {"文章版本已变化，请刷新目录后重试", "File version changed. Refresh the list and retry."},
    {"文章版本校验失败", "File version check failed."},
    {"断开", "Disconnect"},
    {"无", "None"},
    {"无操作后休眠", "Idle sleep"},
    {"无操作时自动锁屏并休眠", "Lock and sleep automatically when idle."},
    {"无法准备空闲固件分区", "Cannot prepare the inactive firmware partition."},
    {"无法切换到新固件", "Cannot switch to the new firmware."},
    {"无法启动WiFi，请稍后重试", "Cannot start WiFi. Retry later."},
    {"无法启动升级任务，请重试", "Cannot start update task. Retry."},
    {"无法启动同步任务，请稍后重试", "Cannot start sync task. Retry later."},
    {"无法打开图书，请检查文件", "Cannot open book. Check the file."},
    {"无法校准系统时间，请检查网络", "Cannot set system time. Check the network."},
    {"无法连接WiFi，请重试", "Cannot connect to WiFi. Retry."},
    {"无线网络", "Wireless network"},
    {"无背景图", "No background"},
    {"日", "Day"},
    {"日期", "Date"},
    {"日期与时间", "Date & time"},
    {"日期未知 · %llu KB", "Unknown date · %llu KB"},
    {"日期格式", "Date format"},
    {"时", "Hour"},
    {"时间从早到晚", "Oldest first"},
    {"时间从晚到早", "Newest first"},
    {"时间已保存，并同步到电源管理芯片", "Time saved and synced to the PMU."},
    {"显示、连接与设备", "Display, connections & device"},
    {"显示与个性化", "Display & personalization"},
    {"显示密码", "Show password"},
    {"显示插图", "Show images"},
    {"显示日期", "Show date"},
    {"普通", "Normal"},
    {"暂不支持", "Unsupported"},
    {"暂无其他阅读图书", "No other recently read books."},
    {"暂无分项耗电数据", "Per-feature battery use is unavailable."},
    {"暂无图书，请传入 TXT 或 EPUB", "No books yet. Add TXT or EPUB files."},
    {"暂无阅读图书", "No recently read book."},
    {"暂无阅读文档", "No recently read documents."},
    {"暂未发布在线升级版本", "No online update released yet."},
    {"更多", "More"},
    {"更新通道", "Update channel"},
    {"最多四行，超出请缩短后保存；留空隐藏", "Up to four lines. Shorten before saving; leave blank to hide."},
    {"最多输入%u行", "Up to %u lines"},
    {"最近阅读", "Recent"},
    {"最近阅读与四周阅读记录", "Recent reading & four-week history"},
    {"月", "Month"},
    {"服务启动后显示访问地址", "Address appears when the service starts."},
    {"服务已开启", "Service running"},
    {"未保存 · ", "Unsaved · "},
    {"未充电", "Not charging"},
    {"未发现网络，请靠近路由器后重扫", "No networks found. Move closer and rescan."},
    {"未命名", "Untitled"},
    {"未命名章节", "Untitled section"},
    {"未导入", "Not imported"},
    {"未开始阅读", "Not started"},
    {"未找到 Pico-settings.backup", "Pico-settings.backup not found."},
    {"未找到图片，请放入 TF 卡的 pictures 文件夹", "No images found. Add images to pictures on the TF card."},
    {"未找到已保存的WiFi", "No saved WiFi found."},
    {"未挂载", "Not mounted"},
    {"未挂载TF卡，仅显示近期记录", "TF card unavailable; showing recent history only."},
    {"未知", "Unknown"},
    {"未设置", "Not set"},
    {"未设置  ›", "Not set  ›"},
    {"未设置日期", "Date not set"},
    {"未连接WiFi", "WiFi disconnected"},
    {"未配置", "Not configured"},
    {"未配置  ›", "Not configured  ›"},
    {"未配置账号", "Account not configured"},
    {"本书", "books"},
    {"本周已读%llu小时%llu分", "This week: %lluh %llum"},
    {"本地升级", "Local update"},
    {"本次阅读", "This session"},
    {"本章", "Chapter"},
    {"本章 %u/%u 页 · %u/%u 节", "Chapter %u/%u pages · %u/%u sections"},
    {"本轮访问预算已用完，请稍后再试", "Request budget reached. Try later."},
    {"本页全选", "Select page"},
    {"本页设置仅对文档阅读生效", "These settings apply to documents only."},
    {"松手跳转至 %u%%", "Release to jump to %u%%"},
    {"查看  ›", "View  ›"},
    {"查看目录，打开或管理已有图书", "Browse folders to open or manage books."},
    {"标准", "Standard"},
    {"标题与正文字号", "Heading & body sizes"},
    {"根目录为空", "Root folder is empty."},
    {"根目录：Pico-IF-update.bin", "Root: Pico-IF-update.bin"},
    {"检查失败，请检查网络与系统时间", "Check failed. Verify network and system time."},
    {"检查更新", "Check for updates"},
    {"模拟器请使用页面下方连接配置", "Use the connection controls below in the simulator."},
    {"模拟数据 · 真机使用实际电量记录", "Demo data; hardware uses measured battery history."},
    {"正在下载并安装…", "Downloading and installing…"},
    {"正在传输，请完成后再断开", "Finish the transfer before disconnecting."},
    {"正在传输，请完成后再更换网络", "Transfer active. Finish before changing networks."},
    {"正在停止…", "Stopping…"},
    {"正在准备 TF 卡", "Preparing TF card…"},
    {"正在准备传书…", "Preparing transfer…"},
    {"正在切换下载线路…", "Switching download route…"},
    {"正在卸载本机 TF 卡并启动 USB…", "Unmounting TF and starting USB…"},
    {"正在同步…", "Syncing…"},
    {"正在复核文件版本…", "Rechecking file version…"},
    {"正在安装，请勿断电", "Installing. Keep power connected."},
    {"正在扫描 2.4 GHz WiFi", "Scanning 2.4 GHz WiFi…"},
    {"正在接收", "Receiving"},
    {"正在校验固件完整性…", "Verifying firmware…"},
    {"正在检查更新…", "Checking for updates…"},
    {"正在生成二维码…", "Generating QR code…"},
    {"正在获取网络时间…", "Getting network time…"},
    {"正在读取坚果云目录…", "Reading Nutstore folder…"},
    {"正在读取目录…", "Reading file list…"},
    {"正在进入", "Entering…"},
    {"正在连接 %s…", "Connecting to %s…"},
    {"正在连接WiFi…", "Connecting WiFi…"},
    {"正在连接…", "Connecting…"},
    {"正在连接已保存网络…", "Connecting to saved network…"},
    {"正在重启", "Restarting"},
    {"正在重试下载…", "Retrying download…"},
    {"正在重试连接…", "Retrying connection…"},
    {"正文", "Body"},
    {"正文、关联插图与阅读记录将一起删除", "Remove text, linked images and reading history."},
    {"正文字号", "Body size"},
    {"正文效果", "Body appearance"},
    {"此处没有子文件夹", "No subfolders here."},
    {"此字体正在使用，请切换其他字体后再更新", "Font in use. Switch to another font before updating it."},
    {"此插图暂无法显示", "Image unavailable."},
    {"此文件夹内没有可用图片", "No usable images in this folder."},
    {"此文件夹没有可用图片，请重新选择", "No usable images in this folder. Select another."},
    {"此目录还没有文件", "This folder is empty."},
    {"此网络认证暂不支持，请选择其他网络", "Unsupported authentication. Choose another network."},
    {"此通道暂未发布版本", "No release in this channel yet."},
    {"段距", "Paragraph gap"},
    {"每 %u 页", "Every %u pages"},
    {"每15分钟记录一次，休眠和关机期间留白", "Sampled every 15 minutes; sleep and power-off periods are blank."},
    {"每次休眠随机更换，多张图片连续不重复", "Random image at each sleep; no repeat when multiple images exist."},
    {"水波纹", "Ripple"},
    {"沉浸", "Immersive"},
    {"没有匹配的文档", "No matching documents."},
    {"没有发现可用网络", "No networks found."},
    {"没有可用的打开方式", "No available way to open this file."},
    {"测试版 ›", "Beta ›"},
    {"浏览 TF 卡", "Browse TF card"},
    {"消", "cel"},
    {"添加", "Add"},
    {"添加当前位置书签", "Bookmark current page"},
    {"添加或移除书签", "Toggle bookmark"},
    {"清理待重试", "Cleanup pending"},
    {"清空", "Clear"},
    {"清空后可用撤回恢复", "Undo can restore the canvas."},
    {"清空画布？", "Clear canvas?"},
    {"清进度", "Clear progress"},
    {"清除勾选", "Clear selection"},
    {"清除进度：", "Clear progress: "},
    {"清除选中的 %u 篇阅读进度？", "Clear progress for %u selected documents?"},
    {"灰阶测试图 / TF 卡 JPG PNG", "Grayscale test / TF JPG & PNG"},
    {"点上方 + 或下方 − 调整数字", "Tap + above or − below to adjust."},
    {"点下方按钮自动重试", "Tap below to retry."},
    {"点按删除", "Tap to delete"},
    {"点线", "Dotted"},
    {"点选文字定位光标", "Tap text to position the cursor."},
    {"热点", "Hotspot"},
    {"热点传书", "Hotspot transfer"},
    {"热点传书未启动", "Hotspot transfer not started."},
    {"热点就绪后显示访问地址", "Address appears when the hotspot is ready."},
    {"热点或已有 WiFi，浏览器上传", "Upload using a hotspot or existing WiFi"},
    {"版式", "Layout"},
    {"特大", "Extra large"},
    {"状态栏中间显示，留空则隐藏", "Shown in the status bar center; leave blank to hide."},
    {"状态栏显示", "Status bar"},
    {"状态栏签名", "Status signature"},
    {"用于官网完整刷机或故障恢复", "For full installation or recovery using the website."},
    {"由 Pico 创建临时网络，离线也能传书", "Pico creates a temporary network; no router needed."},
    {"电压 %.2f V", "Voltage %.2f V"},
    {"电压暂不可用", "Voltage unavailable"},
    {"电池管理", "Battery"},
    {"电源选项", "Power options"},
    {"电脑刷机", "USB flashing"},
    {"电脑刷机  ›", "USB flashing  ›"},
    {"电脑已连接", "Computer connected"},
    {"电量记录", "Battery history"},
    {"画布尚未保存", "Unsaved canvas"},
    {"目录", "Contents"},
    {"目录不存在：%.60s", "Folder not found: %.60s"},
    {"目录中还没有可读内容", "No supported files in this folder."},
    {"目录已读取，共%u项内容", "Folder loaded: %u items."},
    {"目录已读取，请勾选需要下载的内容", "List loaded. Select files to download."},
    {"目录路径过长", "Folder path too long."},
    {"目录过大或不完整", "Folder too large or incomplete."},
    {"目录过大或不完整，请拆分同步文件夹", "Folder too large or incomplete. Split the sync folder."},
    {"目标位置", "Target position"},
    {"目标已有同名项目", "An item with this name already exists."},
    {"目标设定", "Target"},
    {"目标路径过长", "Destination path too long."},
    {"短按：面板", "Press: panel"},
    {"确认", "Confirm"},
    {"确认 IF Edition 升级", "Confirm IF Edition update"},
    {"确认切回稳定版？", "Return to the stable version?"},
    {"确认删除", "Delete"},
    {"确认删除文件？", "Delete this file?"},
    {"确认升级", "Confirm update"},
    {"确认后，短按电源键将显示此图片", "Press power to show this image after confirming."},
    {"确认安装", "Confirm install"},
    {"确认安装这个版本？", "Install this version?"},
    {"确认清除", "Clear"},
    {"确认清除进度？", "Clear reading progress?"},
    {"确认遗忘", "Forget"},
    {"磁盘名称  SD_CARD", "Disk name  SD_CARD"},
    {"移出书架", "Remove from shelf"},
    {"移动", "Move"},
    {"移动到此处", "Move here"},
    {"移动失败，请检查 TF 卡", "Move failed. Check the TF card."},
    {"移动完成", "Move complete."},
    {"移除当前位置书签", "Remove current bookmark"},
    {"稳定版 ›", "Stable ›"},
    {"空格", "Space"},
    {"立刻", "Refresh"},
    {"立刻刷新", "Refresh now"},
    {"立即同步  ›", "Sync now  ›"},
    {"立即重启", "Restart now"},
    {"章", "Chapter"},
    {"章节", "Section"},
    {"章节 %u", "Chapter %u"},
    {"第", "No."},
    {"第 %d / %d 页　Page %d / %d", "Page %d / %d · Page %d / %d"},
    {"第 %u 节", "Section %u"},
    {"等待上传", "Waiting for upload"},
    {"等待电脑连接", "Waiting for computer"},
    {"等待网络地址…", "Waiting for network address…"},
    {"管理", "Manage"},
    {"管理图书", "Manage books"},
    {"管理文档", "Manage documents"},
    {"篇文档", "documents"},
    {"系统与设备", "System & device"},
    {"系统文字", "System text"},
    {"系统时间已设置，PMU 同步失败", "System time set; PMU sync failed."},
    {"系统目录不可修改", "System folders cannot be changed."},
    {"系统语言", "System language"},
    {"约第 %d / %d 页 · 第 %u～%u 节", "About page %d / %d · Sections %u–%u"},
    {"结束 USB 读卡", "Stop USB storage"},
    {"结束删除书签", "Finish deleting bookmarks"},
    {"继续编辑", "Keep editing"},
    {"编辑  ›", "Edit  ›"},
    {"编辑书籍", "Edit book"},
    {"编辑内容", "Edit content"},
    {"缩小字号", "Smaller text"},
    {"网络对时失败，请检查网络后重试", "Time sync failed. Check the network and retry."},
    {"网络对时超时，请检查网络后重试", "Time sync timed out. Check the network and retry."},
    {"网络已停止", "Network stopped."},
    {"网络忙", "Network busy"},
    {"网络校时失败", "Network time sync failed."},
    {"网络正在结束，请稍后再试", "Network is stopping. Try later."},
    {"置顶", "Pin"},
    {"置顶保存失败，请重试", "Cannot save pin. Try again."},
    {"置顶图书始终排在最前", "Pinned books always appear first."},
    {"置顶文档始终排在最前", "Pinned documents always appear first."},
    {"翻页", "Page turns"},
    {"翻页效果", "Page effect"},
    {"背景", "Background"},
    {"自动休眠", "Auto sleep"},
    {"自定义字体与阅读布局", "Custom fonts & reading layouts"},
    {"至少一张可用图片 · 只读取本层文件", "At least one valid image; current folder only."},
    {"英文大写", "Uppercase English"},
    {"英文小写", "Lowercase English"},
    {"虚线", "Dashed"},
    {"行距", "Line spacing"},
    {"解析图片链接", "Parse image links"},
    {"解码失败或内存不足", "Decode failed or low memory."},
    {"设为壁纸锁屏？", "Use this lock wallpaper?"},
    {"设为锁屏壁纸", "Set lock wallpaper"},
    {"设备已连接；手机需同网", "Pico is connected; use the same network on your phone."},
    {"设置  ›", "Set  ›"},
    {"设置 Settings", "Settings"},
    {"设置 ›", "Set ›"},
    {"设置路径过长", "Settings path too long."},
    {"设置路径过长，无法移动", "Settings path too long to move."},
    {"设置页「保存与恢复」功能会将本页设置一并备份", "Save & restore also backs up these settings."},
    {"设置首页banner及壁纸", "Set home Banner & wallpaper"},
    {"访问受限，稍后重试", "Access limited. Try later."},
    {"请从下方列表选择 2.4 GHz WiFi", "Select a 2.4 GHz WiFi network below."},
    {"请先在 WiFi 设置中配置网络", "Configure a network in WiFi settings first."},
    {"请先在设置中配置WiFi", "Configure WiFi in Settings first."},
    {"请先在设置中配置WiFi网络", "Configure WiFi in Settings first."},
    {"请先结束传输后重试", "Finish the transfer and retry."},
    {"请先结束传输并连接WiFi", "Finish the transfer and connect WiFi first."},
    {"请先结束同步或USB连接", "Stop sync or USB storage first."},
    {"请先设置日期与时间", "Set the date and time first."},
    {"请先连接WiFi", "Connect WiFi first."},
    {"请先连接已有WiFi，关闭设备热点或其他传输", "Connect to WiFi; stop the device hotspot or other transfers first."},
    {"请先选择候选字", "Select a candidate character first."},
    {"请先选择候选字，或输入原文", "Select a character or use raw input first."},
    {"请先选择图书", "Select books first."},
    {"请先选择文档", "Select documents first."},
    {"请先配置WiFi", "Configure WiFi first."},
    {"请在内容页删除文档，图片会随文档清理", "Delete documents from Content to remove linked images too."},
    {"请在设置中配置坚果云账号和应用密码", "Configure your Nutstore account and app password in Settings."},
    {"请插入并挂载TF卡后同步", "Insert and mount the TF card before syncing."},
    {"请放入 IF Edition 升级包", "Copy an IF Edition update to the card."},
    {"请检查 TF 卡", "Check the TF card."},
    {"请检查TF卡、结束同步或先重试恢复", "Check the TF card; stop sync or retry restore first."},
    {"请检查TF卡，并先结束坚果云同步", "Check the TF card and stop Nutstore sync first."},
    {"请用 USB 连接电脑，再打开官网刷机页", "Connect USB, then open the web installer on your computer."},
    {"请输入有效文件名", "Enter a valid file name."},
    {"请靠近路由器后重新扫描", "Move closer to the router and rescan."},
    {"读取图片失败或内存不足", "Cannot read image or low memory."},
    {"读取失败，请重试", "Read failed. Retry."},
    {"读取完成后可勾选下载", "Select files after the list loads."},
    {"读取已保存网络失败，请重试", "Cannot read saved network. Retry."},
    {"读取文件", "Read file"},
    {"调整后保留当前阅读位置", "Keep the current reading position after changes."},
    {"账号", "Account"},
    {"账号与链接", "Accounts & connections"},
    {"账号为坚果云账号", "Enter your Nutstore account."},
    {"账号或应用密码错误", "Incorrect account or app password."},
    {"跟随系统字体", "Use system font"},
    {"跳到目录位置", "Jump to section"},
    {"跳转", "Jump"},
    {"跳转失败，请重试", "Jump failed. Retry."},
    {"输入内容无效", "Invalid input."},
    {"输入原文", "Use raw input"},
    {"近24小时", "Last 24 hours"},
    {"近七天", "Last 7 days"},
    {"返回文件管理", "Back to Files"},
    {"返回跳转前", "Back to origin"},
    {"还没有 Markdown 文档", "No Markdown documents yet."},
    {"这本书没有可用目录", "This book has no table of contents."},
    {"进入 BOOT 模式", "Enter BOOT mode"},
    {"进度从低到高", "Progress: low to high"},
    {"进度从高到低", "Progress: high to low"},
    {"进度清理失败，请重新尝试", "Progress cleanup failed. Try again."},
    {"进度清理失败，请重试", "Progress cleanup failed. Retry."},
    {"连接", "Connect"},
    {"连接 Pico 热点", "Connect to Pico hotspot"},
    {"连接 Pico 热点后上传图书", "Connect to Pico's hotspot to upload books."},
    {"连接 WiFi", "Connect WiFi"},
    {"连接后可传书和对时", "Connect to transfer files and sync time."},
    {"连接后，可退出此页继续使用。", "You can leave this page once connected."},
    {"连接启动失败，请重试", "Cannot start connection. Retry."},
    {"连接失败，请检查密码或信号", "Connection failed. Check password or signal."},
    {"连接成功", "Connected"},
    {"连接或更改网络", "Connect or change network"},
    {"连接状态", "Connection"},
    {"连接电脑，把图书放入 books 文件夹", "Connect USB and copy books into books."},
    {"退出", "Exit"},
    {"退出全屏阅读书签列表立刻刷新", "Exit fullscreen bookmarks refresh now"},
    {"退出此页后，WiFi 仍保持连接。", "WiFi stays connected after leaving this page."},
    {"选择  ›", "Choose  ›"},
    {"选择 TF 卡中的图片文件夹", "Choose an image folder on the TF card."},
    {"选择单张图片或默认壁纸", "Choose one image or the default wallpaper."},
    {"选择字体", "Choose font"},
    {"选择导入方式", "Choose an import method"},
    {"选择左上角显示的日期格式", "Choose the date format for the top-left clock."},
    {"选择操作，轻触弹窗外取消", "Choose an action; tap outside to cancel."},
    {"选择方式", "Choose method"},
    {"选择电源菜单中“关机”的方式", "Choose what Shut down does in the power menu."},
    {"选择百分比，先预览目标位置", "Select a percentage to preview the destination."},
    {"选择目标文件夹", "Choose destination"},
    {"选择背景图片", "Choose background"},
    {"选择轮播文件夹", "Shuffle folder"},
    {"通过 WiFi 对时", "Sync time over WiFi"},
    {"通过有线连接管理文件", "Manage files over USB"},
    {"通过浏览器管理文件", "Manage files in your browser"},
    {"遗忘失败，请重试或取消", "Cannot forget network. Retry or cancel."},
    {"遗忘网络", "Forget network"},
    {"部分内容同步失败", "Some files failed to sync."},
    {"部分文件过大或名称过长，未列入", "Some files omitted: size or name too long."},
    {"部分目录或文件不可读，请检查后重扫", "Some folders or files cannot be read. Check and rescan."},
    {"配网后可在日期与时间中进行 WiFi 对时。", "After connecting, sync the clock in Date & time."},
    {"配置  ›", "Configure  ›"},
    {"配置与阅读记录已恢复", "Settings and history restored."},
    {"配置与阅读记录已恢复；WiFi 请重新连接", "Settings and history restored; reconnect WiFi."},
    {"配置文件损坏或版本不兼容", "Backup is damaged or incompatible."},
    {"重启", "Restart"},
    {"重命名", "Rename"},
    {"重命名失败，请检查 TF 卡", "Rename failed. Check the TF card."},
    {"重命名完成", "Rename complete."},
    {"重新扫描", "Rescan"},
    {"重新检查 TF 卡", "Recheck TF card"},
    {"重新进入传书可使用内置存储", "Reopen transfer to use internal storage."},
    {"重试扫描", "Rescan"},
    {"重试清理", "Retry cleanup"},
    {"重试热点传书", "Retry hotspot transfer"},
    {"锁屏壁纸", "Lock wallpaper"},
    {"锁屏画面保留；深睡后短按电源键开机", "Keep the lock screen; press power to wake from deep sleep."},
    {"长按文件或文件夹打开操作", "Long-press a file or folder for actions."},
    {"长按正文", "Hold body text"},
    {"长按电源键开机", "Hold power to start."},
    {"长按：首页", "Hold: Home"},
    {"阅读字体", "Reading font"},
    {"阅读打卡", "Record"},
    {"阅读文字 Aa", "Reading text Aa"},
    {"阅读线", "Reading line"},
    {"阅读记录", "Reading history"},
    {"阅读设置", "Reading settings"},
    {"阅读进度", "Progress"},
    {"阅读进度 %u%%", "Progress %u%%"},
    {"阅读进度%u%%", "Progress %u%%"},
    {"阅读面板", "Reading panel"},
    {"附近未找到已保存的WiFi", "No saved WiFi found nearby."},
    {"附近未找到已保存的WiFi，请前往设置", "No saved WiFi nearby. Open settings."},
    {"附近网络", "Nearby networks"},
    {"隐藏密码", "Hide password"},
    {"需要密码", "Password required"},
    {"面板", "Panel"},
    {"页边距", "Page margin"},
    {"项", "items"},
    {"预览壁纸", "Wallpaper preview"},
    {"预览暂不可用", "Preview unavailable"},
    {"预览暂不可用，请重试", "Preview unavailable. Try again."},
    {"首行缩进", "First-line indent"},
    {"首页 Home", "Home"},
    {"首页Banner", "Home Banner"},
    {"首页强刷", "Full refresh on Home"},
    {"首页文字字体", "Banner font"},
    {"首页格言", "Home quote"},
    {"高度调节", "Height"},
    {"默认", "Default"},
    {"默认字体", "Default font"},
    {"默认字体（完整字库补字）", "Default font (full character fallback)"},
    {"；勾选项可重试", "; retry checked items"},
    {"；所选可重试", "; retry selected items"},
